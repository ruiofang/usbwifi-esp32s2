## sdkconfig.defaults
```kconfig
CONFIG_IDF_TARGET_ESP32S2=y
CONFIG_ESPTOOLPY_FLASH_MODE_QIO=y
CONFIG_ESPTOOLPY_FLASH_SIZE_4MB=y
CONFIG_ESPTOOLPY_FLASH_FREQ_80M=y

# USB CDC Console
CONFIG_ESP_CONSOLE_USB_CDC=y
CONFIG_ESP_CONSOLE_UART_NUM=-1
CONFIG_ESP_CONSOLE_USB_CDC_RX_BUF_SIZE=1024
CONFIG_ESP_CONSOLE_USB_CDC_SUPPORT_ETS_PRINTF=y
# CONFIG_ESP32S2_KEEP_USB_ALIVE is not set

# Bootloader and Logs (set NONE to suppress; change to INFO for troubleshooting)
CONFIG_BOOTLOADER_LOG_LEVEL_NONE=y
CONFIG_LOG_DEFAULT_LEVEL_INFO=y

CONFIG_ESP_SYSTEM_PANIC_SILENT_REBOOT=y
CONFIG_ESP_MAIN_TASK_STACK_SIZE=8192
CONFIG_ESP_SYSTEM_EVENT_TASK_STACK_SIZE=4096

CONFIG_WIFI_ENABLED=y
CONFIG_WIFI_STA_ENABLED=y
CONFIG_WIFI_AP_ENABLED=y
CONFIG_WIFI_SOFTAP_SUPPORT_MAX_STA_CONN=1

CONFIG_LWIP_IPV4=y
CONFIG_LWIP_DHCP_SERVER=y
CONFIG_LWIP_DHCP_CLIENT=y
CONFIG_LWIP_TCP=y
CONFIG_LWIP_UDP=y

CONFIG_ESP_TASK_WDT_ENABLE=n
```
